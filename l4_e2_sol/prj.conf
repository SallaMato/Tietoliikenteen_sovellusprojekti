## CMakeLists.txt
```
#
# Copyright (c) 2018 Nordic Semiconductor
#
# SPDX-License-Identifier: LicenseRef-Nordic-5-Clause
#
cmake_minimum_required(VERSION 3.20.0)

find_package(Zephyr REQUIRED HINTS $ENV{ZEPHYR_BASE})
project(NONE)

# NORDIC SDK APP START
target_sources(app PRIVATE
  src/main.c
  src/my_lbs.c
  #src/adc.c
  src/fast_adc.c
)

# NORDIC SDK APP END
zephyr_library_include_directories(.)
```

## prj.conf
```kconfig
#
# Copyright (c) 2018 Nordic Semiconductor
#
# SPDX-License-Identifier: LicenseRef-Nordic-5-Clause
#

# Logger module
CONFIG_LOG=y

# Button and LED library
CONFIG_DK_LIBRARY=y

# Bluetooth LE
CONFIG_BT=y
CONFIG_BT_PERIPHERAL=y
CONFIG_BT_DEVICE_NAME="RYHMA4"

# Increase stack size for the main thread and System Workqueue
CONFIG_SYSTEM_WORKQUEUE_STACK_SIZE=2048
CONFIG_MAIN_STACK_SIZE=2048

#laitteistoajurit
CONFIG_NRFX_SAADC=y
CONFIG_NRFX_GPPI=y
CONFIG_NRFX_TIMER=y

# Suuremmat BLE-paketit (Data Length Extension & MTU)
CONFIG_BT_USER_DATA_LEN_UPDATE=y
CONFIG_BT_CTLR_DATA_LENGTH_MAX=251
CONFIG_BT_BUF_ACL_TX_SIZE=251
CONFIG_BT_BUF_ACL_RX_SIZE=251
CONFIG_BT_L2CAP_TX_MTU=247

# Yhteyden parametrit. ...MIN_INT ja ...MAX_INT päättävät connection intervallin, 
# eli sen kuinka usein laitteet "heräävät" kommunikoimaan. Kun laitteet eivät
# kommunikoi, bluetooth radio on pois päältä. Pienin mahdollinen arvo on 6. 
# HUOM! Lopullisen arvon päättää central, eli vaikka tässä yritetään asettaa se 
# 6:seen, ei näin välttämättä lopulta tapahdu. 
CONFIG_BT_PERIPHERAL_PREF_MIN_INT=6
CONFIG_BT_PERIPHERAL_PREF_MAX_INT=6
CONFIG_BT_PERIPHERAL_PREF_LATENCY=0
CONFIG_BT_PERIPHERAL_PREF_TIMEOUT=400
CONFIG_BT_GAP_AUTO_UPDATE_CONN_PARAMS=y

# Mahdollistaa PHY updatet
CONFIG_BT_USER_PHY_UPDATE=y

# Tarvitaan jotta MTU asetuksia voi muuttaa: bt_gatt_exchange_mtu()
CONFIG_BT_GATT_CLIENT=y
```

## boards/nrf5340dk_nrf5340_cpuapp.overlay
```dts
&timer2 {
    status = "okay";
};

&adc {
    status = "okay";
};
```

## src/main.c
```c
/*
 * Copyright (c) 2023 Nordic Semiconductor ASA
 *
 * SPDX-License-Identifier: LicenseRef-Nordic-5-Clause
 */

#include <zephyr/kernel.h>
#include <zephyr/logging/log.h>
#include <zephyr/bluetooth/bluetooth.h>
#include <zephyr/bluetooth/gap.h>
#include <zephyr/bluetooth/uuid.h>
#include <zephyr/bluetooth/gatt.h>
#include <zephyr/bluetooth/conn.h>
#include <dk_buttons_and_leds.h>
#include "my_lbs.h"
#include "fast_adc.h"
//muistikopiointia varten (memcpy)
#include <string.h>

extern struct k_msgq fast_adc_msgq;

static struct bt_gatt_exchange_params exchange_params;
static void exchange_func(struct bt_conn *conn, uint8_t att_err, 
	struct bt_gatt_exchange_params *params);

static const struct bt_le_adv_param *adv_param = BT_LE_ADV_PARAM(
	(BT_LE_ADV_OPT_CONN |
	 BT_LE_ADV_OPT_USE_IDENTITY), /* Connectable advertising and use identity address */
	800, /* Min Advertising Interval 500ms (800*0.625ms) */
	801, /* Max Advertising Interval 500.625ms (801*0.625ms) */
	NULL); /* Set to NULL for undirected advertising */

LOG_MODULE_REGISTER(Lesson4_Exercise2, LOG_LEVEL_INF);

#define DEVICE_NAME CONFIG_BT_DEVICE_NAME
#define DEVICE_NAME_LEN (sizeof(DEVICE_NAME) - 1)

#define RUN_STATUS_LED DK_LED1
#define CON_STATUS_LED DK_LED2
#define USER_LED DK_LED3
#define USER_BUTTON DK_BTN1_MSK
#define USER_BUTTON2 DK_BTN2_MSK


#define STACKSIZE 1024
#define PRIORITY 7

#define RUN_LED_BLINK_INTERVAL 1000
/* STEP 17 - Define the interval at which you want to send data at */
#define NOTIFY_INTERVAL 500
static bool app_button_state;
static struct k_work adv_work;
static bool should_collect_data = false;
static int packets_sent = 0;

//(0 = X alas, 1 = X ylos, 2 = Y alas, 3 = Y ylös, 4 = Z alas, 5 = Z ylös)
volatile int suunta = 0;

static const struct bt_data ad[] = {
	BT_DATA_BYTES(BT_DATA_FLAGS, (BT_LE_AD_GENERAL | BT_LE_AD_NO_BREDR)),
	BT_DATA(BT_DATA_NAME_COMPLETE, DEVICE_NAME, DEVICE_NAME_LEN),

};

static const struct bt_data sd[] = {
	BT_DATA_BYTES(BT_DATA_UUID128_ALL, BT_UUID_LBS_VAL),
};

static void adv_work_handler(struct k_work *work)
{
	int err = bt_le_adv_start(adv_param, ad, ARRAY_SIZE(ad), sd, ARRAY_SIZE(sd));

	if (err) {
		printk("Advertising failed to start (err %d)\n", err);
		return;
	}

	printk("Advertising successfully started\n");
}
static void advertising_start(void)
{
	k_work_submit(&adv_work);
}
static void recycled_cb(void)
{
	printk("Connection object available from previous conn. Disconnect is complete!\n");
	advertising_start();
}

static void app_led_cb(bool led_state)
{
	dk_set_led(USER_LED, led_state);
}

static bool app_button_cb(void)
{
	return app_button_state;
}

/* STEP 18.1 - Define the thread function  */
void send_data_thread(void)
{
	struct fast_adc_msg msg; //Muuttuja, johon tallennetaan viestijonosta luettu viesti (struct fast_adc_msg)

	//Luodaan BLE-paketti (1 tavu suunta + 240 tavua dataa = 241 tavua)

    uint8_t ble_payload[241];
	
	while (1) {

		// k_msgq_get pysäyttää tämän säikeen (se menee nukkumaan) K_FOREVER-ajaksi,
		// kunnes viestijonossa on viesti fast_adc.c:stä.
		// Kun viesti tulee, se tallentuu 'msg' muuttujaan.
		if (k_msgq_get(&fast_adc_msgq, &msg, K_FOREVER) == 0) {

			//Nyt data on kerätty. msg.buffer on taulukko (X, Y,Z, X, Y,Z..) ja msg.size on 300.

			if (should_collect_data) {

				printk("Paketti saatu. Suunta: %d,Ensimmäinen näyte: X:%d Y:%d Z:%d\n", 
                     suunta, msg.buffer[0], msg.buffer[1], msg.buffer[2]);
				
				//Laitetaan suunta paketin ensimmäiseksi tavuksi
                ble_payload[0] = suunta;
				
				// Kopioidaan ADC-data (120 int16_t arvoa = 240 tavua) suunnan perään.
                // msg.buffer sisältää datan.
                memcpy(&ble_payload[1], msg.buffer, 240);

				//Lähetetään 241 tavun paketti BLE yli
				int err = my_lbs_send_payload(ble_payload, sizeof(ble_payload));
				if (err) {
    				printk("notify err: %d\n", err);
				} else {
					// 
					packets_sent++;
					if (packets_sent >= 410) { // 400 * 40 = 16 000 näytettä
						should_collect_data = false;
						dk_set_led_off(USER_LED);
						printk("16 000 näytettä lähetetty.\n");
					}
				}
			}
		}
	}
}

static struct my_lbs_cb app_callbacks = {
	.led_cb = app_led_cb,
	.button_cb = app_button_cb,
};

static void button_changed(uint32_t button_state, uint32_t has_changed)
{
	if (has_changed & USER_BUTTON) {
		uint32_t user_button_state = button_state & USER_BUTTON;
		/* STEP 6 - Send indication on a button press */
		my_lbs_send_button_state_indicate(user_button_state);
		app_button_state = user_button_state ? true : false;
		if (user_button_state) {
			suunta = (suunta + 1) % 6;
			
		} 
		
	}
	if (has_changed & USER_BUTTON2) {
		uint32_t user_button_state = button_state & USER_BUTTON2;
		/* STEP 6 - Send indication on a button press */
		//my_lbs_send_button_state_indicate(user_button_state);
		app_button_state = user_button_state ? true : false;
		if (user_button_state && !should_collect_data) {
			packets_sent = 0;
			should_collect_data = true;
			printk("Nappia 2 painettu\n");
		}
	}
}

static void update_data_length(struct bt_conn *conn)
{
    int err;
    struct bt_conn_le_data_len_param data_len = {
        .tx_max_len = BT_GAP_DATA_LEN_MAX,
        .tx_max_time = BT_GAP_DATA_TIME_MAX,
    };
    err = bt_conn_le_data_len_update(conn, &data_len);
    if (err) {
        printk("data_len_update failed (err %d)\n", err);
    }
}

static void update_mtu(struct bt_conn *conn)
{
    int err;
    exchange_params.func = exchange_func;

    err = bt_gatt_exchange_mtu(conn, &exchange_params);
    if (err) {
        printk("bt_gatt_exchange_mtu failed (err %d)\n", err);
    }
}

static void on_connected(struct bt_conn *conn, uint8_t err)
{
	if (err) {
		printk("Connection failed (err %u)\n", err);
		return;
	}
	
    const struct bt_conn_le_phy_param preferred_phy = {
        .options = BT_CONN_LE_PHY_OPT_NONE,
        .pref_rx_phy = BT_GAP_LE_PHY_2M,
        .pref_tx_phy = BT_GAP_LE_PHY_2M,
    };

    int result = bt_conn_le_phy_update(conn, &preferred_phy);
    if (result) {
        printk("bt_conn_le_phy_update() returned %d\n", err);
    }
	
	k_sleep(K_MSEC(1000));  // Delay added to avoid link layer collisions.
	update_data_length(conn);
	update_mtu(conn);

	printk("Connected\n");
	dk_set_led_on(CON_STATUS_LED);
}

static void on_disconnected(struct bt_conn *conn, uint8_t reason)
{
	printk("Disconnected (reason %u)\n", reason);

	dk_set_led_off(CON_STATUS_LED);
}

static void on_param_updated(struct bt_conn *conn, uint16_t interval, 
	uint16_t latency, uint16_t timeout)
{
	printk("params updated: interval[%u], latency[%u], timeout[%u]\n",
		interval, latency, timeout);
}

void on_le_phy_updated(struct bt_conn *conn, struct bt_conn_le_phy_info *param)
{
    // PHY Updated
    if (param->tx_phy == BT_CONN_LE_TX_POWER_PHY_1M) {
        printk("PHY updated. New PHY: 1M\n");
    }
    else if (param->tx_phy == BT_CONN_LE_TX_POWER_PHY_2M) {
        printk("PHY updated. New PHY: 2M\n");
    }
    else if (param->tx_phy == BT_CONN_LE_TX_POWER_PHY_CODED_S8) {
        printk("PHY updated. New PHY: Long Range\n");
    }
}

void on_le_data_len_updated(struct bt_conn *conn, struct bt_conn_le_data_len_info *info)
{
    uint16_t tx_len     = info->tx_max_len; 
    uint16_t tx_time    = info->tx_max_time;
    uint16_t rx_len     = info->rx_max_len;
    uint16_t rx_time    = info->rx_max_time;
    printk("Data length updated. Length %d/%d bytes, time %d/%d us\n", tx_len, rx_len, tx_time, rx_time);
}

static void exchange_func(struct bt_conn *conn, uint8_t att_err,
			  struct bt_gatt_exchange_params *params)
{
	printk("MTU exchange %s\n", att_err == 0 ? "successful" : "failed");
    if (!att_err) {
        uint16_t payload_mtu = bt_gatt_get_mtu(conn) - 3;   // 3 bytes used for Attribute headers.
        printk("New MTU: %d bytes\n", payload_mtu);
    }
}

struct bt_conn_cb connection_callbacks = {
	.connected = on_connected,
	.disconnected = on_disconnected,
	.recycled = recycled_cb,
	.le_param_updated = on_param_updated,
	.le_phy_updated = on_le_phy_updated,
	.le_data_len_updated = on_le_data_len_updated
};

static int init_button(void)
{
	int err;

	err = dk_buttons_init(button_changed);
	if (err) {
		printk("Cannot init buttons (err: %d)\n", err);
	}

	return err;
}

int main(void)
{
	int blink_status = 0;
	int err;

	LOG_INF("Starting Lesson 4 - Exercise 2 \n");

	err = dk_leds_init();
	if (err) {
		LOG_ERR("LEDs init failed (err %d)\n", err);
		return -1;
	}

	err = init_button();
	if (err) {
		printk("Button init failed (err %d)\n", err);
		return -1;
	}

	err = bt_enable(NULL);
	if (err) {
		LOG_ERR("Bluetooth init failed (err %d)\n", err);
		return -1;
	}

	bt_conn_cb_register(&connection_callbacks);

	err = my_lbs_init(&app_callbacks);
	if (err) {
		printk("Failed to init LBS (err:%d)\n", err);
		return -1;
	}

	LOG_INF("Bluetooth initialized\n");
	k_work_init(&adv_work, adv_work_handler);
	advertising_start();

	// Käynnistetään nopea ADC
	fast_adc_init_and_start();

	for (;;) {
		dk_set_led(RUN_STATUS_LED, (++blink_status) % 2);
		k_sleep(K_MSEC(RUN_LED_BLINK_INTERVAL));
	}
}
/* STEP 18.2 - Define and initialize a thread to send data periodically */
K_THREAD_DEFINE(send_data_thread_id, STACKSIZE, send_data_thread, NULL, NULL, NULL, PRIORITY, 0, 0);
```

## src/adc.h
```c
#ifndef ADC_H_KJJ
#define ADC_H_KJJ

struct Measurement
{
   uint16_t suunta;
   uint16_t x;
   uint16_t y;
   uint16_t z;
};

int initializeADC(void);
struct Measurement readADCValue(void);
void printDebugInfo(void);


#endif
```

## src/fast_adc.c
```c
/* Alkuperäinen adc koodissa main.c pyysi arvon ADC:ltä. ADC luki arvon ja antoi sen takaisin. Tämä tapa on helppo, mutta hidas.
Uudella menetelmällä laitteisto kerää dataa taustalla satoja kertoja sekunnissa. Kun 300 arvon puskuri on täynnä, tapahtuu keskeytys (interrupt).
Keskeytys pysäyttää prosessorin nanosekunneissa ja pakottaa sen suorittamaan saadc_event_handler funktion.
Keskeytyksen aikana ei saa lähettää BLE yli tai tulostaa sarjaporttiin, koska muuten laite jumiutuu.

Ratkaisuna käytetään viestijonoa (Message Queue). Zephyr käyttöjärjestelmässä on tätä varten työkalu k_msgq.*/


#include <zephyr/kernel.h>
#include <zephyr/logging/log.h>
#include <nrfx_saadc.h>
#include <nrfx_timer.h>
#include <helpers/nrfx_gppi.h>

#include "fast_adc.h"

LOG_MODULE_REGISTER(FastADC, LOG_LEVEL_INF);

/* STEP 3.1 - Define the SAADC sample interval in microseconds */
// 16 000 näytettä varten kahden jakson välinen aika olisi 62,5us. Tässä voi käyttää vain kokonaislukuja, joten pyöristetään.
//Voi myös kokeilla muuttaa ajastimen käyttämään suoraan ajastimen kelloa.
#define SAADC_SAMPLE_INTERVAL_US 62

/* STEP 4.1 - Define the buffer size for the SAADC */
// SAADC tallentaa dataa puskuriin saadc_sample_buffer. Kun mitataan kolmea kanavaa, joka kerta kun ajastin laukaisee
// SAADC ottaa kolme näytettä (x, y, z) ja laittaa ne puskuriin peräkkäin ([X1, Y1, Z1, X2, Y2, Z2,..]).
//Jos halutaan kerätä 16 000 näytettä kolmelta kanavalta, tarvitaan 16 000 * 3 = 48 000 arvoa sekunnissa. Laitteen muisti todennäköisesti loppuisi
//joten käytetään mallipohjan pingpong-puskuria.
// --> laitteisto täyttää puskuria 0, ja kun se on täynnä, tapahtuu NRFX_SAADC_EVT_DONE - keskeytys, ja laitteisto alkaa automaattisesti
//täyttämään puskuria 1. Keskeytyksen aikana voidaan lähettää puskurin 0 data eteenpäin.
// Asetetaan puskurin kooksi 300 (100 näytettä * 3)
// 5.11 muutettu paketin kooksi 120 (40 näytettä * 3) koska 120 arvoa * 2 (uint16) = 240 tavua -> tämä mahtuu BLE paketti rajaan
#define SAADC_BUFFER_SIZE   120

// Luodaan Message Queue.
// Määritellään jono 'fast_adc_msgq' joka ottaa vastan 'struct fast_adc_msg' tyyppisiä viestejä.
// Jonoon mahtuu kerrallaan 4 viestiä.
K_MSGQ_DEFINE(fast_adc_msgq, sizeof(struct fast_adc_msg), 4, 4);

static nrfx_timer_t timer_instance = NRFX_TIMER_INSTANCE(NRF_TIMER2);
static int16_t saadc_sample_buffer[2][SAADC_BUFFER_SIZE];
static uint32_t saadc_current_buffer = 0;

//Määritellään kolme kanavaa, joista luetaan x, y ja z akselin arvoja
static nrfx_saadc_channel_t channels[3] = {
    NRFX_SAADC_DEFAULT_CHANNEL_SE(NRFX_ANALOG_EXTERNAL_AIN0, 0),
    NRFX_SAADC_DEFAULT_CHANNEL_SE(NRFX_ANALOG_EXTERNAL_AIN1, 1),
    NRFX_SAADC_DEFAULT_CHANNEL_SE(NRFX_ANALOG_EXTERNAL_AIN2, 2)
};


static void configure_timer(void)
{
    int err;
    nrfx_timer_config_t timer_config = NRFX_TIMER_DEFAULT_CONFIG(1000000);
    err = nrfx_timer_init(&timer_instance, &timer_config, NULL);

    uint32_t timer_ticks = nrfx_timer_us_to_ticks(&timer_instance, SAADC_SAMPLE_INTERVAL_US);
    nrfx_timer_extended_compare(&timer_instance, NRF_TIMER_CC_CHANNEL0, timer_ticks, NRF_TIMER_SHORT_COMPARE0_CLEAR_MASK, false);
}

static void saadc_event_handler(nrfx_saadc_evt_t const * p_event)
{
    switch (p_event->type)
    {
        case NRFX_SAADC_EVT_READY:
            nrfx_timer_enable(&timer_instance);
            break;                        
            
        case NRFX_SAADC_EVT_BUF_REQ:
            nrfx_saadc_buffer_set(saadc_sample_buffer[(saadc_current_buffer++)%2], SAADC_BUFFER_SIZE);
            break;

        case NRFX_SAADC_EVT_DONE:
        {
            // Kun puskuri on täynnä, luodaan viesti (struct fast_adc_msg) ja laitetaan se viestijonoon (k_msgq_put).
            struct fast_adc_msg msg;
            msg.buffer = (int16_t *)p_event->data.done.p_buffer;
            msg.size = p_event->data.done.size;

            // k_msgq_put laittaa viestin jonoon. K_NO_WAIT tarkoittaa, että jos jono on aivan täynnä, keskeytys ei jää odottamaan, vaan jatkaa matkaa.
            k_msgq_put(&fast_adc_msgq, &msg, K_NO_WAIT);
        }
        break;
        
        default:
            break;
    }
}

static void configure_saadc(void)
{
    int err;

    /*  Yhdistetään ADC:n keskeytys Zephyrin järjestelmään */
    IRQ_CONNECT(DT_IRQN(DT_NODELABEL(adc)),
                DT_IRQ(DT_NODELABEL(adc), priority),
                nrfx_isr, nrfx_saadc_irq_handler, 0);

    /*  Alustetaan ADC-ajuri */
    err = nrfx_saadc_init(DT_IRQ(DT_NODELABEL(adc), priority));
    if (err != 0) {
        LOG_ERR("nrfx_saadc_init error: %08x", err);
        return;
    }

    channels[0].channel_config.gain = NRF_SAADC_GAIN1_6;
    channels[1].channel_config.gain = NRF_SAADC_GAIN1_6;
    channels[2].channel_config.gain = NRF_SAADC_GAIN1_6;
    
    /* Ladataan kanavien X, Y ja Z asetukset ADC:lle */
    err = nrfx_saadc_channels_config(channels, 3);
    if (err != 0) {
        LOG_ERR("nrfx_saadc_channels_config error: %08x", err);
        return;
    }

    /*  Määritetään Advanced mode ja aktivoidaan kanavat 0, 1 ja 2.
    BIT(0) on X, BIT(1) on Y, BIT(2) on Z. 
    Advanced mode: Yhdistää laitteistotason ajastimen, ADC:n ja EasyDMA:n (suora muistiosoitus). 
    Ajastin laukaisee ADC:n automaattisesti taustalla, ja ADC tallentaa tulokset suoraan RAM-muistiin puskuriin herättämättä prosessoria. 
    Prosessori herää vasta sitten, kun koko puskuri (esim. 300 arvoa) on täynnä, jolloin prosessori voi lähettää sen kerralla Bluetoothilla.*/
    nrfx_saadc_adv_config_t saadc_adv_config = NRFX_SAADC_DEFAULT_ADV_CONFIG;
    err = nrfx_saadc_advanced_mode_set(BIT(0) | BIT(1) | BIT(2),
                                       NRF_SAADC_RESOLUTION_12BIT,
                                       &saadc_adv_config,
                                       saadc_event_handler);
    if (err != 0) {
        LOG_ERR("nrfx_saadc_advanced_mode_set error: %08x", err);
        return;
    }
                                            
    /* Asetetaan kaksi puskuria ping-pong -keräystä varten */
    err = nrfx_saadc_buffer_set(saadc_sample_buffer[0], SAADC_BUFFER_SIZE);
    if (err != 0) {
        LOG_ERR("nrfx_saadc_buffer_set 0 error: %08x", err);
        return;
    }
    err = nrfx_saadc_buffer_set(saadc_sample_buffer[1], SAADC_BUFFER_SIZE);
    if (err != 0) {
        LOG_ERR("nrfx_saadc_buffer_set 1 error: %08x", err);
        return;
    }

    /*Asetetaan ADC valmiustilaan odottamaan ajastimen liipaisua */
    err = nrfx_saadc_mode_trigger();
    if (err != 0) {
        LOG_ERR("nrfx_saadc_mode_trigger error: %08x", err);
        return;
    }
}

static void configure_ppi(void)
{
    int err;
    /* STEP 6.1 - Declare variables used to hold the (D)PPI channel number */
    nrfx_gppi_handle_t gppi_handle_sample;
    nrfx_gppi_handle_t gppi_handle_start;

    /* STEP 6.2 - Trigger task sample from timer */
    err = nrfx_gppi_conn_alloc( nrfx_timer_compare_event_address_get(&timer_instance, NRF_TIMER_CC_CHANNEL0),nrf_saadc_task_address_get(NRF_SAADC, NRF_SAADC_TASK_SAMPLE), &gppi_handle_sample);
    if (err != 0) {
        LOG_ERR("nrfx_gppi_conn_alloc error: %08x", err);
        return;
    }

    /* STEP 6.3 - Trigger task start from end event */
    err = nrfx_gppi_conn_alloc(nrf_saadc_event_address_get(NRF_SAADC, NRF_SAADC_EVENT_END),nrf_saadc_task_address_get(NRF_SAADC, NRF_SAADC_TASK_START), &gppi_handle_start);
    if (err != 0) {
        LOG_ERR("nrfx_gppi_conn_alloc error: %08x", err);
        return;
    }

    /* STEP 6.4 - Enable both (D)PPI channels */ 
    nrfx_gppi_conn_enable(gppi_handle_sample);
    nrfx_gppi_conn_enable(gppi_handle_start);
}


// Funktio, jota main.c kutsuu. Käynnistää ajastimen ja ADC:n
void fast_adc_init_and_start(void)
{
    configure_timer();
    configure_saadc();  
    configure_ppi();
}
```

## src/fast_adc.h
```c
/* Alkuperäinen adc koodissa main.c pyysi arvon ADC:ltä. ADC luki arvon ja antoi sen takaisin. Tämä tapa on helppo, mutta hidas.
Uudella menetelmällä laitteisto kerää dataa taustalla satoja kertoja sekunnissa. Kun 300 arvon puskuri on täynnä, tapahtuu keskeytys (interrupt).
Keskeytys pysäyttää prosessorin nanosekunneissa ja pakottaa sen suorittamaan saadc_event_handler funktion.
Keskeytyksen aikana ei saa lähettää BLE yli tai tulostaa sarjaporttiin, koska muuten laite jumiutuu.

Ratkaisuna käytetään viestijonoa (Message Queue). Zephyr käyttöjärjestelmässä on tätä varten työkalu k_msgq.*/

#ifndef FAST_ADC_H_
#define FAST_ADC_H_

#include <zephyr/kernel.h>

// Paketti, joka lähetetään keskeytyksestä main.c:lle.
// Paketti ei sisällä dataa, koska se olisi liian hidasta kopioida.
// --> Paketti sisältää vain osoittimen (pointer) siihen RAM-muistin kohtaan, jossa data on
struct fast_adc_msg {
    int16_t *buffer; // Osoite RAM-muistiin, jossa 300 arvoa ovat
    uint16_t size;   // Arvojen määrä (esim. 300)
};


// Funktio, jota main.c kutsuu käynnistääkseen keräyksen.
void fast_adc_init_and_start(void); 

#endif
```

## src/my_lbs.c
```c
/*
 * Copyright (c) 2018 Nordic Semiconductor ASA
 *
 * SPDX-License-Identifier: LicenseRef-Nordic-5-Clause
 */

/** @file
 *  @brief LED Button Service (LBS) sample
 */

#include <zephyr/types.h>
#include <stddef.h>
#include <string.h>
#include <errno.h>
#include <zephyr/sys/printk.h>
#include <zephyr/sys/byteorder.h>
#include <zephyr/kernel.h>
#include <zephyr/logging/log.h>
#include <zephyr/bluetooth/bluetooth.h>
#include <zephyr/bluetooth/hci.h>
#include <zephyr/bluetooth/conn.h>
#include <zephyr/bluetooth/uuid.h>
#include <zephyr/bluetooth/gatt.h>
#include "adc.h"
#include "my_lbs.h"

LOG_MODULE_DECLARE(Lesson4_Exercise2);

static bool notify_mysensor_enabled;
static bool indicate_enabled;
static bool button_state;
static struct my_lbs_cb lbs_cb;

/* STEP 4 - Define an indication parameter */
static struct bt_gatt_indicate_params ind_params;

/* STEP 3 - Implement the configuration change callback function */
static void mylbsbc_ccc_cfg_changed(const struct bt_gatt_attr *attr, uint16_t value)
{
	indicate_enabled = (value == BT_GATT_CCC_INDICATE);
}

/* STEP 13 - Define the configuration change callback function for the MYSENSOR characteristic */
static void mylbsbc_ccc_mysensor_cfg_changed(const struct bt_gatt_attr *attr, uint16_t value)
{
	notify_mysensor_enabled = (value == BT_GATT_CCC_NOTIFY);
}

// This function is called when a remote device has acknowledged the indication at its host layer
static void indicate_cb(struct bt_conn *conn, struct bt_gatt_indicate_params *params, uint8_t err)
{
	LOG_DBG("Indication %s\n", err != 0U ? "fail" : "success");
}
static ssize_t write_led(struct bt_conn *conn, const struct bt_gatt_attr *attr, const void *buf,
			 uint16_t len, uint16_t offset, uint8_t flags)
{
	LOG_DBG("Attribute write, handle: %u, conn: %p", attr->handle, (void *)conn);

	if (len != 1U) {
		LOG_DBG("Write led: Incorrect data length");
		return BT_GATT_ERR(BT_ATT_ERR_INVALID_ATTRIBUTE_LEN);
	}

	if (offset != 0) {
		LOG_DBG("Write led: Incorrect data offset");
		return BT_GATT_ERR(BT_ATT_ERR_INVALID_OFFSET);
	}

	if (lbs_cb.led_cb) {
		// Read the received value
		uint8_t val = *((uint8_t *)buf);

		if (val == 0x00 || val == 0x01) {
			// Call the application callback function to update the LED state
			lbs_cb.led_cb(val ? true : false);
		} else {
			LOG_DBG("Write led: Incorrect value");
			return BT_GATT_ERR(BT_ATT_ERR_VALUE_NOT_ALLOWED);
		}
	}

	return len;
}

static ssize_t read_button(struct bt_conn *conn, const struct bt_gatt_attr *attr, void *buf,
			   uint16_t len, uint16_t offset)
{
	// get a pointer to button_state which is passed in the BT_GATT_CHARACTERISTIC() and stored in attr->user_data
	const char *value = attr->user_data;

	LOG_DBG("Attribute read, handle: %u, conn: %p", attr->handle, (void *)conn);

	if (lbs_cb.button_cb) {
		// Call the application callback function to update the get the current value of the button
		button_state = lbs_cb.button_cb();
		return bt_gatt_attr_read(conn, attr, buf, len, offset, value, sizeof(*value));
	}

	return 0;
}

/* LED Button Service Declaration */
BT_GATT_SERVICE_DEFINE(
	my_lbs_svc, BT_GATT_PRIMARY_SERVICE(BT_UUID_LBS),
	/* STEP 1 - Modify the Button characteristic declaration to support indication */
	BT_GATT_CHARACTERISTIC(BT_UUID_LBS_BUTTON, BT_GATT_CHRC_READ | BT_GATT_CHRC_INDICATE,
			       BT_GATT_PERM_READ, read_button, NULL, &button_state),
	/* STEP 2 - Create and add the Client Characteristic Configuration Descriptor */
	BT_GATT_CCC(mylbsbc_ccc_cfg_changed, BT_GATT_PERM_READ | BT_GATT_PERM_WRITE),

	BT_GATT_CHARACTERISTIC(BT_UUID_LBS_LED, BT_GATT_CHRC_WRITE, BT_GATT_PERM_WRITE, NULL,
			       write_led, NULL),

	/* STEP 12 - Create and add the MYSENSOR characteristic and its CCCD  */
	BT_GATT_CHARACTERISTIC(BT_UUID_LBS_MYSENSOR, BT_GATT_CHRC_NOTIFY, BT_GATT_PERM_NONE, NULL,
			       NULL, NULL),

	BT_GATT_CCC(mylbsbc_ccc_mysensor_cfg_changed, BT_GATT_PERM_READ | BT_GATT_PERM_WRITE),
);

/* A function to register application callbacks for the LED and Button characteristics  */
int my_lbs_init(struct my_lbs_cb *callbacks)
{
	if (callbacks) {
		lbs_cb.led_cb = callbacks->led_cb;
		lbs_cb.button_cb = callbacks->button_cb;
	}

	return 0;
}

/* STEP 5 - Define the function to send indications */
int my_lbs_send_button_state_indicate(bool button_state)
{
	if (!indicate_enabled) {
		return -EACCES;
	}
	ind_params.attr = &my_lbs_svc.attrs[2];
	ind_params.func = indicate_cb; // A remote device has ACKed at its host layer (ATT ACK)
	ind_params.destroy = NULL;
	ind_params.data = &button_state;
	ind_params.len = sizeof(button_state);
	return bt_gatt_indicate(NULL, &ind_params);
}

/* STEP 14 - Define the function to send notifications for the MYSENSOR characteristic */
/*int my_lbs_send_sensor_notify(struct Measurement sensor_value)
{
	if (!notify_mysensor_enabled) {
		return -EACCES;
	}

	return bt_gatt_notify(NULL, &my_lbs_svc.attrs[7], &sensor_value, sizeof(sensor_value));
}*/

int my_lbs_send_payload(uint8_t *data, uint16_t length)
{
    
    if (!notify_mysensor_enabled) {
        return -ENOTCONN;
    }

    return bt_gatt_notify(NULL, &my_lbs_svc.attrs[7], data, length);
}
```

## src/my_lbs.h
```c
/*
 * Copyright (c) 2018 Nordic Semiconductor ASA
 *
 * SPDX-License-Identifier: LicenseRef-Nordic-5-Clause
 */

#ifndef BT_LBS_H_
#define BT_LBS_H_

/**@file
 * @defgroup bt_lbs LED Button Service API
 * @{
 * @brief API for the LED Button Service (LBS).
 */
#include "adc.h"
#ifdef __cplusplus
extern "C" {
#endif

#include <zephyr/types.h>

/** @brief LBS Service UUID. */
#define BT_UUID_LBS_VAL BT_UUID_128_ENCODE(0x00001523, 0x1212, 0xefde, 0x1523, 0x785feabcd123)

/** @brief Button Characteristic UUID. */
#define BT_UUID_LBS_BUTTON_VAL                                                                     \
	BT_UUID_128_ENCODE(0x00001524, 0x1212, 0xefde, 0x1523, 0x785feabcd123)

/** @brief LED Characteristic UUID. */
#define BT_UUID_LBS_LED_VAL BT_UUID_128_ENCODE(0x00001525, 0x1212, 0xefde, 0x1523, 0x785feabcd123)

/** @brief LED Characteristic UUID. */
#define BT_UUID_LBS_MYSENSOR_VAL                                                                   \
	BT_UUID_128_ENCODE(0x00001526, 0x1212, 0xefde, 0x1523, 0x785feabcd123)

#define BT_UUID_LBS_SUUNTA_VAL                                                                   \
	BT_UUID_128_ENCODE(0x00001527, 0x1212, 0xefde, 0x1523, 0x785feabcd123)

#define BT_UUID_LBS BT_UUID_DECLARE_128(BT_UUID_LBS_VAL)
#define BT_UUID_LBS_BUTTON BT_UUID_DECLARE_128(BT_UUID_LBS_BUTTON_VAL)
#define BT_UUID_LBS_LED BT_UUID_DECLARE_128(BT_UUID_LBS_LED_VAL)
#define BT_UUID_LBS_MYSENSOR BT_UUID_DECLARE_128(BT_UUID_LBS_MYSENSOR_VAL)
#define BT_UUID_LBS_SUUNTA BT_UUID_DECLARE_128(BT_UUID_LBS_SUUNTA_VAL)

/** @brief Callback type for when an LED state change is received. */
typedef void (*led_cb_t)(const bool led_state);

/** @brief Callback type for when the button state is pulled. */
typedef bool (*button_cb_t)(void);

/** @brief Callback struct used by the LBS Service. */
struct my_lbs_cb {
	/** LED state change callback. */
	led_cb_t led_cb;
	/** Button read callback. */
	button_cb_t button_cb;
};

/** @brief Initialize the LBS Service.
 *
 * This function registers application callback functions with the My LBS
 * Service
 *
 * @param[in] callbacks Struct containing pointers to callback functions
 *			used by the service. This pointer can be NULL
 *			if no callback functions are defined.
 *
 *
 * @retval 0 If the operation was successful.
 *           Otherwise, a (negative) error code is returned.
 */
int my_lbs_init(struct my_lbs_cb *callbacks);

/** @brief Send the button state as indication.
 *
 * This function sends a binary state, typically the state of a
 * button, to all connected peers.
 *
 * @param[in] button_state The state of the button.
 *
 * @retval 0 If the operation was successful.
 *           Otherwise, a (negative) error code is returned.
 */
int my_lbs_send_button_state_indicate(bool button_state);

/** @brief Send the button state as notification.
 *
 * This function sends a binary state, typically the state of a
 * button, to all connected peers.
 *
 * @param[in] button_state The state of the button.
 *
 * @retval 0 If the operation was successful.
 *           Otherwise, a (negative) error code is returned.
 */
int my_lbs_send_button_state_notify(bool button_state);

/** @brief Send the sensor value as notification.
 *
 * This function sends an uint32_t  value, typically the value
 * of a simulated sensor to all connected peers.
 *
 * @param[in] sensor_value The value of the simulated sensor.
 *
 * @retval 0 If the operation was successful.
 *           Otherwise, a (negative) error code is returned.
 */
//int my_lbs_send_sensor_notify(struct Measurement sensor_value);

// Uusi lähetysfunktio, joka ottaa vastaan tavutaulukon ja sen pituuden
int my_lbs_send_payload(uint8_t *data, uint16_t length);

int my_lbs_send_suunta_notify(uint32_t suunta_value);

#ifdef __cplusplus
}
#endif

/**
 * @}
 */

#endif /* BT_LBS_H_ */
```
